## CMakeLists.txt
```
cmake_minimum_required(VERSION 3.20.0)

find_package(Zephyr REQUIRED HINTS $ENV{ZEPHYR_BASE})
project(embedded_hal_i2c)

rust_cargo_application()
target_sources(app PRIVATE src/devicetree_wrapper.c 
                           src/i2c_wrapper.c)
```

## prj.conf
```kconfig
CONFIG_GPIO=y
CONFIG_I2C=y

CONFIG_PRINTK=y
CONFIG_LOG=y
CONFIG_CONSOLE=y
CONFIG_STDOUT_CONSOLE=y
CONFIG_NCS_BOOT_BANNER=y

## Use RTT
CONFIG_USE_SEGGER_RTT=y
CONFIG_RTT_CONSOLE=y
CONFIG_LOG_BACKEND_RTT=y
CONFIG_UART_CONSOLE=n

## Rust config
# Increase stack size for Rust main function
CONFIG_MAIN_STACK_SIZE=4096
# Enable Rust support
CONFIG_RUST=y
# Enable Rust allocator
CONFIG_RUST_ALLOC=y   
```

## xiao_nrf52840.overlay
```dts
/ {
	lsm6ds3tr-c-en {
		regulator-boot-on;
	};
};
```

## src/devicetree_wrapper.c
```c
#include <zephyr/kernel.h>
#include <zephyr/sys/printk.h>
#include <zephyr/drivers/i2c.h>

#define DT_LSM6DS3TR_C DT_NODELABEL(lsm6ds3tr_c)
static const struct i2c_dt_spec i2c_lsm6ds3tr_c = I2C_DT_SPEC_GET(DT_LSM6DS3TR_C);

const struct i2c_dt_spec* devicetree_get_i2c_lsm6ds3tr_c(void) { return &i2c_lsm6ds3tr_c; }
```

## src/i2c_wrapper.c
```c
#include <zephyr/kernel.h>
#include <zephyr/sys/printk.h>
#include <zephyr/drivers/i2c.h>

#include <stdint.h>

int zephyr_i2c_read_dt(const struct i2c_dt_spec * spec, uint8_t * buf, uint32_t num_bytes )
{
    return i2c_read_dt(spec, buf, num_bytes);
}


int zephyr_i2c_transfer(const struct device *dev, struct i2c_msg *msgs, uint8_t num_msgs, uint16_t addr)
{
    return i2c_transfer(dev, msgs, num_msgs, addr);
}
int zephyr_i2c_transfer_dt(const struct i2c_dt_spec * spec, struct i2c_msg *msgs, uint8_t num_msgs, uint16_t addr)
{
    return i2c_transfer(spec->bus, msgs, num_msgs, addr);
}
```
