## CMakeLists.txt
```
cmake_minimum_required(VERSION 3.20.0)

find_package(Zephyr REQUIRED HINTS $ENV{ZEPHYR_BASE})
project(embedded_hal_uart)

rust_cargo_application()
target_sources(app PRIVATE src/devicetree_wrapper.c 
                           src/uart_wrapper.c)
```

## prj.conf
```kconfig
CONFIG_GPIO=y
CONFIG_SERIAL=y
CONFIG_UART_ASYNC_API=y
CONFIG_UART_0_ASYNC=y
CONFIG_UART_0_INTERRUPT_DRIVEN=n

CONFIG_PRINTK=y
CONFIG_LOG=y
CONFIG_CONSOLE=y
CONFIG_STDOUT_CONSOLE=y
CONFIG_NCS_BOOT_BANNER=y

## Use RTT
CONFIG_USE_SEGGER_RTT=y
CONFIG_RTT_CONSOLE=y
CONFIG_LOG_BACKEND_RTT=y
CONFIG_UART_CONSOLE=n

## Rust config
# Increase stack size for Rust main function
CONFIG_MAIN_STACK_SIZE=4096
# Enable Rust support
CONFIG_RUST=y
# Enable Rust allocator
CONFIG_RUST_ALLOC=y   

# Enable debug build including Rust code.
# Enable this if you want to debug the Rust code
# CONFIG_DEBUG=y
```

## src/devicetree_wrapper.c
```c
#include <zephyr/kernel.h>
#include <zephyr/sys/printk.h>
#include <zephyr/drivers/uart.h>

#define DT_UART0 DT_NODELABEL(uart0)
static const struct device* uart0 = DEVICE_DT_GET(DT_UART0);

const struct device* devicetree_get_uart0(void) { return uart0; }
```

## src/uart_wrapper.c
```c
#include <zephyr/kernel.h>
#include <zephyr/drivers/uart.h>

#include <stdint.h>

int zephyr_uart_callback_set (const struct device *dev, uart_callback_t callback, void *user_data) {
    return uart_callback_set(dev, callback, user_data);
}
```
